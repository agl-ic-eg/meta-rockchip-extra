## conf/machine/rockchip-rk3588-nanopc-t6.conf
```bitbake
#@TYPE: Machine
#@NAME: RK3588 friendlyelec NanoPC-T6 board

require conf/machine/include/rk3588.inc

MACHINEOVERRIDES .= ":nanopct6"

PREFERRED_VERSION_linux-rockchip := "6.1%"
LINUXLIBCVERSION := "6.1-custom%"
OLDEST_KERNEL := "6.1"

KBUILD_DEFCONFIG = "nanopi6_linux_defconfig"
KERNEL_DEVICETREE = "rockchip/rk3588-nanopi6-rev01.dtb"

UBOOT_MACHINE = "nanopi6_defconfig"

RK_WIFIBT_FIRMWARES = " \
    linux-firmware-rtl8822 \
"

MACHINE_EXTRA_RRECOMMENDS:append = " \
    linux-firmware-rtl8125 \
    ${RK_WIFIBT_FIRMWARES} \
"
```
